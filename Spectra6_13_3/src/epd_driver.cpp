// epd_driver.cpp — Waveshare 13.3" e-Paper HAT+ (E) / E Ink Spectra 6
// Controller: dual SSD1677-equivalent (master = left half, slave = right half)
// Resolution: 1200×1600 (portrait hardware), used as 1600×1200 landscape
//
// Architecture notes
// ──────────────────
// The panel contains TWO independent SPI controllers sharing SCK/MOSI/DC/RST/BUSY.
// CS_M selects the Master (left 600 columns), CS_S the Slave (right 600 columns).
// Each controller expects exactly EPD_ROW_BYTES = 300 bytes per row, where every
// nibble (4 bits) encodes one pixel colour from the 6-colour palette.
//
// Flush strategy (band renderer, same API as your Good Display driver)
// ─────────────────────────────────────────────────────────────────────
// We keep one line-pair buffer in RAM (600 bytes — left + right halves).
// The render callback fills the band; we then split and send left to Master,
// right to Slave, line by line.  Total frame = 1200 lines × 300 B × 2 halves
// = 720 000 bytes transferred over SPI.
//
// Colour encoding
// ───────────────
// Each byte holds two pixels: high nibble = pixel at even X, low nibble = odd X.
// Palette codes: BLACK=0x0, WHITE=0x1, RED=0x3, YELLOW=0x4, BLUE=0x5, GREEN=0x6

#include "epd_driver.h"

// ── SPI ────────────────────────────────────────────────────────────────────
static SPIClass _vspi(HSPI);   // the board uses GPIO 13/14 which are the HSPI bus

// ── IO helpers ─────────────────────────────────────────────────────────────
static inline void _csm(bool lo) { digitalWrite(PIN_CS_M, lo ? LOW : HIGH); }
static inline void _css(bool lo) { digitalWrite(PIN_CS_S, lo ? LOW : HIGH); }
static inline void _dc(bool hi)  { digitalWrite(PIN_DC,   hi ? HIGH : LOW); }
static inline void _rst(bool hi) { digitalWrite(PIN_RST,  hi ? HIGH : LOW); }
static inline bool _busy()       { return digitalRead(PIN_BUSY) == HIGH; }

static void _waitBusy(uint32_t timeoutMs = 30000) {
  uint32_t t = millis();
  while (!_busy()) {
    if (millis() - t > timeoutMs) { Serial.println("EPD: BUSY timeout"); return; }
    delay(10);
  }
  delay(20);
}

// Send a command byte — both CS lines held; caller must set CS before calling
static void _sendCmd(uint8_t cmd) {
  _dc(false);                        // DC low  = command
  _vspi.transfer(cmd);
}

// Send a data byte — both CS lines held
static void _sendDat(uint8_t dat) {
  _dc(true);                         // DC high = data
  _vspi.transfer(dat);
}

static void _sendDatBuf(const uint8_t* buf, size_t len) {
  _dc(true);
  _vspi.writeBytes(buf, len);        // DMA-capable bulk transfer
}

// Send command+data to BOTH controllers simultaneously
static void _bothCmd(uint8_t cmd, const uint8_t* data = nullptr, size_t len = 0) {
  _csm(true); _css(true);
  _sendCmd(cmd);
  if (data && len) _sendDatBuf(data, len);
  _csm(false); _css(false);
}

// Send command+data to MASTER only
static void _mCmd(uint8_t cmd, const uint8_t* data = nullptr, size_t len = 0) {
  _csm(true); _css(false);
  _sendCmd(cmd);
  if (data && len) _sendDatBuf(data, len);
  _csm(false);
}

// ── Band pixel buffer ───────────────────────────────────────────────────────
// We keep one full row: EPD_WIDTH pixels = 1600 nibbles = 800 bytes
// Left half:  bytes [0..299]   → sent to Master
// Right half: bytes [300..599] → sent to Slave
#define ROW_BUF_BYTES  800   // 1600 px × 4bpp / 8
static uint8_t _rowBuf[ROW_BUF_BYTES];

// Current band boundaries (set by EPD_flush before calling the callback)
static int _bandTop = 0;
static int _bandBot = 0;

// ── Pixel setter ────────────────────────────────────────────────────────────
// Coordinates: x ∈ [0, EPD_WIDTH), y ∈ [0, EPD_HEIGHT)
// _rowBuf covers rows [_bandTop, _bandBot); y must be in range.
static void _setPixel(int x, int y, uint8_t pix) {
  if (x < 0 || x >= EPD_WIDTH || y < _bandTop || y >= _bandBot) return;
  // Pack two pixels per byte: high nibble = even x, low nibble = odd x
  int idx = x / 2;   // byte index in the row buffer for the current row
  if (x & 1)
    _rowBuf[idx] = (_rowBuf[idx] & 0xF0) | (pix & 0x0F);
  else
    _rowBuf[idx] = (_rowBuf[idx] & 0x0F) | ((pix & 0x0F) << 4);
}

// ── 8×8 pixel font (same table as your Good Display driver) ────────────────
static const uint8_t _font[][8] PROGMEM = {
  {0x00,0x00,0x00,0x00,0x00,0x00,0x00,0x00}, // ' '
  {0x18,0x3C,0x3C,0x18,0x18,0x00,0x18,0x00}, // !
  {0x36,0x36,0x00,0x00,0x00,0x00,0x00,0x00}, // "
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  {0x6E,0x3B,0x00,0x00,0x00,0x00,0x00,0x00}, // ~
};

// ── Drawing primitives ──────────────────────────────────────────────────────
void EPD_drawChar(int x, int y, char c, uint8_t pix, int scale) {
  if (c < 32 || c > 126) return;
  const uint8_t* g = _font[c - 32];
  for (int row = 0; row < 8; row++) {
    uint8_t bits = pgm_read_byte(&g[row]);
    for (int col = 0; col < 8; col++) {
      if (bits & (0x80 >> col)) {
        for (int sy = 0; sy < scale; sy++)
          for (int sx = 0; sx < scale; sx++)
            _setPixel(x + col * scale + sx, y + row * scale + sy, pix);
      }
    }
  }
}

void EPD_drawText(int x, int y, const char* txt, uint8_t pix, int scale) {
  for (int i = 0; txt[i]; i++)
    EPD_drawChar(x + i * (8 * scale + 1), y, txt[i], pix, scale);
}

void EPD_fillRect(int x, int y, int w, int h, uint8_t pix) {
  for (int py = y; py < y + h; py++)
    for (int px = x; px < x + w; px++)
      _setPixel(px, py, pix);
}

// ── Panel init sequence (dual-controller, from Waveshare official driver) ──
static void _panelInit() {
  // Double-reset sequence required for dual-controller power-on
  _rst(HIGH); delay(30);
  _rst(LOW);  delay(30);
  _rst(HIGH); delay(30);
  _rst(LOW);  delay(30);   // second reset cycle — mandatory
  _rst(HIGH); delay(30);

  // -- Commands to BOTH controllers simultaneously --
  { const uint8_t d[] = {0xC0,0x1C,0x1C,0xCC,0xCC,0xCC,0x15,0x15,0x55};
    _bothCmd(0xAA, d, sizeof(d)); }  // AN_TM  (analog timing)

  { const uint8_t d[] = {0x49,0x55,0x13,0x5D,0x05,0x10};
    _bothCmd(0x66, d, sizeof(d)); }  // CMD66

  { const uint8_t d[] = {0xDF,0x69};
    _bothCmd(0x00, d, sizeof(d)); }  // PSR  (panel settings)

  { const uint8_t d[] = {0xF7};
    _bothCmd(0x50, d, sizeof(d)); }  // CDI  (VCOM & data interval)

  { const uint8_t d[] = {0x03,0x03};
    _bothCmd(0x60, d, sizeof(d)); }  // TCON (source & gate timing)

  { const uint8_t d[] = {0x10};
    _bothCmd(0xE0, d, sizeof(d)); }  // AGID

  { const uint8_t d[] = {0x22};
    _bothCmd(0xE3, d, sizeof(d)); }  // PWS

  { const uint8_t d[] = {0x01};
    _bothCmd(0xE9, d, sizeof(d)); }  // CCSET

  // Resolution: 1200(source) × 1600(gate) for each half
  // Sent as big-endian 16-bit pairs
  { const uint8_t d[] = {0x04, 0xB0, 0x06, 0x40};   // 0x04B0=1200, 0x0640=1600
    _bothCmd(0x61, d, sizeof(d)); }  // TRES (resolution)

  // -- Commands to MASTER controller only --
  { const uint8_t d[] = {0x0F,0x00,0x28,0x2C,0x28,0x38};
    _mCmd(0x01, d, sizeof(d)); }     // PWR

  { const uint8_t d[] = {0x07};
    _mCmd(0xE7, d, sizeof(d)); }     // EN_BUF

  { const uint8_t d[] = {0xE8,0x28};
    _mCmd(0x06, d, sizeof(d)); }     // BTST_P (boost positive)

  { const uint8_t d[] = {0x01};
    _mCmd(0xB1, d, sizeof(d)); }     // BOOST_VDDP_EN

  { const uint8_t d[] = {0xE8,0x28};
    _mCmd(0xF0, d, sizeof(d)); }     // BTST_N (boost negative)

  { const uint8_t d[] = {0x01};
    _mCmd(0xB2, d, sizeof(d)); }     // BUCK_BOOST_VDDN

  { const uint8_t d[] = {0x02};
    _mCmd(0xB3, d, sizeof(d)); }     // TFT_VCOM_POWER

  Serial.println("EPD: panel init OK");
}

static void _turnOnDisplay() {
  // PON (power on)
  _csm(true); _css(true);
  _sendCmd(0x04);
  _csm(false); _css(false);
  _waitBusy();

  delay(50);

  // DRF (display refresh)
  { const uint8_t d[] = {0x00};
    _bothCmd(0x12, d, sizeof(d)); }
  _waitBusy(60000);  // full-colour refresh can take up to 40 s

  // POF (power off)
  { const uint8_t d[] = {0x00};
    _bothCmd(0x02, d, sizeof(d)); }
  // NOTE: do not wait busy after POF — matches official Waveshare driver
}

// ── Public API ──────────────────────────────────────────────────────────────
void EPD_init() {
  // GPIO setup
  pinMode(PIN_CS_M,  OUTPUT); digitalWrite(PIN_CS_M, HIGH);
  pinMode(PIN_CS_S,  OUTPUT); digitalWrite(PIN_CS_S, HIGH);
  pinMode(PIN_DC,    OUTPUT); digitalWrite(PIN_DC,   HIGH);
  pinMode(PIN_RST,   OUTPUT); digitalWrite(PIN_RST,  HIGH);
  pinMode(PIN_BUSY,  INPUT);

  // SPI @ 8 MHz (safe; can try 16 MHz if transfers are reliable)
  _vspi.begin(PIN_CLK, -1, PIN_MOSI, PIN_CS_M);  // SCK, MISO(unused), MOSI, SS(unused)
  _vspi.beginTransaction(SPISettings(8000000, MSBFIRST, SPI_MODE0));

  delay(100);
  _panelInit();
}

void EPD_sleep() {
  _csm(true); _css(true);
  _sendCmd(0x07);
  _sendDat(0xA5);
  _csm(false); _css(false);
  delay(100);
  Serial.println("EPD: sleeping");
}

// ── Full-frame flush ────────────────────────────────────────────────────────
// Process one row at a time.  Each row is EPD_WIDTH pixels = ROW_BUF_BYTES bytes.
// Left  half (x 0..599)   → 300 bytes → sent to Master
// Right half (x 600..1199)→ 300 bytes → sent to Slave
//
// We call the render callback with a 1-row band so memory stays tiny,
// but batch the SPI write per row to avoid per-pixel overhead.

void EPD_flush(EPD_RenderFn fn) {
  Serial.println("EPD: flushing...");

  // Open data write on Master
  _csm(true); _css(false);
  _sendCmd(0x10);
  _dc(true);   // switch to data mode for bulk transfer
  _csm(false);

  // Open data write on Slave
  _css(true); _csm(false);
  _sendCmd(0x10);
  _dc(true);
  _css(false);

  // Interleave: for each row send left half to M, then right half to S
  for (int y = 0; y < EPD_HEIGHT; y++) {
    // Fill row buffer with white
    memset(_rowBuf, (PIX_WHITE << 4) | PIX_WHITE, ROW_BUF_BYTES);

    // Let application draw into this row
    _bandTop = y;
    _bandBot = y + 1;
    fn(y, y + 1);

    // Send left half (bytes 0..299) to Master
    _csm(true); _css(false);
    _dc(true);
    _vspi.writeBytes(_rowBuf, EPD_ROW_BYTES);
    _csm(false);

    // Send right half (bytes 300..599) to Slave
    _css(true); _csm(false);
    _dc(true);
    _vspi.writeBytes(_rowBuf + EPD_ROW_BYTES, EPD_ROW_BYTES);
    _css(false);

    if (y % 120 == 0)
      Serial.printf("EPD: row %d / %d\n", y, EPD_HEIGHT);
  }

  // Deselect all, then trigger display refresh
  _csm(false); _css(false);

  _turnOnDisplay();
  Serial.println("EPD: flush done");
}
