// epd_driver.cpp — GDEM102F91 10.2" 4-color e-ink driver
// Manufacturer: Good Display  Controller: SSD2677
// Confirmed working on Waveshare ESP32 Universal Driver Board Rev.3
//
// To adapt for a different panel:
//   1. Change EPD_SOURCE / EPD_GATE in epd_driver.h
//   2. Replace EPD_init() register sequence below
//   3. Adjust PIX_* color values if panel uses different encoding
//   Everything else (band renderer, font, drawing primitives) stays the same.

#include "epd_driver.h"

// ── SPI instance ──────────────────────────────────────────────────────────────
static SPIClass _hspi(HSPI);

// ── IO macros ─────────────────────────────────────────────────────────────────
#define CS_LOW   digitalWrite(PIN_CS, LOW)
#define CS_HIGH  digitalWrite(PIN_CS, HIGH)
#define DC_LOW   digitalWrite(PIN_DC, LOW)
#define DC_HIGH  digitalWrite(PIN_DC, HIGH)
#define RST_LOW  digitalWrite(PIN_RST, LOW)
#define RST_HIGH digitalWrite(PIN_RST, HIGH)
#define IS_BUSY  digitalRead(PIN_BUSY)

static void _cmd(uint8_t c)  { CS_LOW; DC_LOW;  _hspi.transfer(c); CS_HIGH; }
static void _dat(uint8_t d)  { CS_LOW; DC_HIGH; _hspi.transfer(d); CS_HIGH; }
static void _waitBusy() {
  unsigned long t = millis();
  while (!IS_BUSY) {
    if (millis()-t > 20000) { Serial.println("EPD: BUSY timeout"); return; }
    delay(5);
  }
}

// ── Band buffer (8 rows × 960 cols × 2bpp = 1920 bytes) ──────────────────────
#define BAND_ROWS  8
#define BAND_BYTES (EPD_SOURCE * BAND_ROWS / 4)
static uint8_t _band[BAND_BYTES];
static int     _bandTop = 0;

// ── Internal pixel setter ─────────────────────────────────────────────────────
static void _setpixel(int x, int y, uint8_t pix) {
  int by = y - _bandTop;
  if (x < 0 || x >= EPD_SOURCE || by < 0 || by >= BAND_ROWS) return;
  int idx   = (by * EPD_SOURCE + x) / 4;
  int shift = 6 - ((by * EPD_SOURCE + x) % 4) * 2;
  _band[idx] = (_band[idx] & ~(0x03 << shift)) | (pix << shift);
}

// ── Font 8×8 ─────────────────────────────────────────────────────────────────
static const uint8_t _font[][8] PROGMEM = {
  {0x00,0x00,0x00,0x00,0x00,0x00,0x00,0x00}, // ' '
  {0x18,0x3C,0x3C,0x18,0x18,0x00,0x18,0x00}, // !
  {0x36,0x36,0x00,0x00,0x00,0x00,0x00,0x00}, // "
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  {0x6E,0x3B,0x00,0x00,0x00,0x00,0x00,0x00}, // ~
};

// ── Public drawing primitives ─────────────────────────────────────────────────
void EPD_drawChar(int x, int y, char c, uint8_t pix, int scale) {
  if (c < 32 || c > 126) return;
  const uint8_t* g = _font[c-32];
  for (int row=0; row<8; row++) {
    uint8_t bits = pgm_read_byte(&g[row]);
    for (int col=0; col<8; col++)
      if (bits & (0x80>>col))
        for (int sy=0; sy<scale; sy++)
          for (int sx=0; sx<scale; sx++)
            _setpixel(x+(7-col)*scale+sx, y+row*scale+sy, pix); // mode1 mirror
  }
}

void EPD_drawText(int x, int y, const char* txt, uint8_t pix, int scale) {
  for (int i=0; txt[i]; i++)
    EPD_drawChar(x + i*(8*scale+1), y, txt[i], pix, scale);
}

void EPD_fillRect(int x, int y, int w, int h, uint8_t pix) {
  for (int py=y; py<y+h; py++)
    for (int px=x; px<x+w; px++)
      _setpixel(px, py, pix);
}

// ── Panel init (GDEM102F91 / SSD2677) ─────────────────────────────────────────
void EPD_init() {
  pinMode(PIN_CS,   OUTPUT); digitalWrite(PIN_CS,   HIGH);
  pinMode(PIN_DC,   OUTPUT); digitalWrite(PIN_DC,   HIGH);
  pinMode(PIN_RST,  OUTPUT); digitalWrite(PIN_RST,  HIGH);
  pinMode(PIN_BUSY, INPUT);
  _hspi.begin(PIN_CLK, PIN_MISO, PIN_MOSI, PIN_CS);
  _hspi.beginTransaction(SPISettings(4000000, MSBFIRST, SPI_MODE0));

  delay(100); RST_LOW; delay(10); RST_HIGH; delay(10); _waitBusy();

  _cmd(0x00); _dat(0x2F); _dat(0x29);
  _cmd(0x03); _dat(0x10); _dat(0x54); _dat(0x44);
  _cmd(0x06); _dat(0x0F); _dat(0x8B); _dat(0x93); _dat(0xa1);
  _cmd(0x41); _dat(0x00);
  _cmd(0x50); _dat(0x37);
  _cmd(0x60); _dat(0x02); _dat(0x02);
  _cmd(0x61);
    _dat(EPD_SOURCE/256); _dat(EPD_SOURCE%256);
    _dat(EPD_GATE/256);   _dat(EPD_GATE%256);
  _cmd(0x65); _dat(0x00); _dat(0x00); _dat(0x00); _dat(0x00);
  _cmd(0xE7); _dat(0x1C);
  _cmd(0xE3); _dat(0x00);
  _cmd(0xE9); _dat(0x01);
  _cmd(0x30); _dat(0x08);
  _cmd(0x62); _dat(0x7D); _dat(0x7D); _dat(0x7D); _dat(0x60);
               _dat(0xA7); _dat(0x93); _dat(0x7D); _dat(0x68);
  _cmd(0x04); _waitBusy();
  Serial.println("EPD: init OK");
}

void EPD_sleep() {
  _cmd(0x02); _dat(0x00); _waitBusy();
  delay(100);
  _cmd(0x07); _dat(0xA5);
  Serial.println("EPD: sleeping");
}

// ── Band flush ────────────────────────────────────────────────────────────────
void EPD_flush(EPD_RenderFn fn) {
  Serial.println("EPD: flushing...");
  _cmd(0x10);
  CS_LOW; DC_HIGH;
  for (int bt=0; bt<EPD_GATE; bt+=BAND_ROWS) {
    _bandTop = bt;
    memset(_band, 0x55, BAND_BYTES); // default: white
    fn(bt, bt+BAND_ROWS);
    _hspi.writeBytes(_band, BAND_BYTES);
  }
  CS_HIGH;
  _cmd(0x12); _dat(0x00); _waitBusy();
  Serial.println("EPD: flush done");
}
